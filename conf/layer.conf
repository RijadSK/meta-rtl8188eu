## conf/layer.conf
```bitbake
# Append conf dir to BBPATH
BBPATH .= ":${LAYERDIR}"

# Append recipe dir to BBFILES
BBFILES += "${LAYERDIR}/recipes*/*/*.bb ${LAYERDIR}/recipes*/*/*.bbappend"

LAYERSERIES_COMPAT_rtlwifi = " warrior zeus dunfell gatesgarth hardknott honister kirkstone langdale mickledore nanbield" 

BBFILE_COLLECTIONS += "rtlwifi"
BBFILE_PRIORITY_rtlwifi = "1"
BBFILE_PATTERN_rtlwifi = "${LAYERDIR}"
IMAGE_INSTALL_append = " rtl8188eu \
                         8188eu-service "
```
